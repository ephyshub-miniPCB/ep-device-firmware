## CMakeLists.txt
```
cmake_minimum_required(VERSION 3.20.0)

# Default `west flash`/`west debug` to the nrfutil runner rather than nrfjprog
# (the legacy nRF Command Line Tools, superseded by nrfutil). Pass `-r <runner>`
# to west to use a different one.
set(BOARD_FLASH_RUNNER nrfutil)

find_package(Zephyr REQUIRED HINTS $ENV{ZEPHYR_BASE})
project(base_node)

target_include_directories(app PRIVATE src)
target_sources(app PRIVATE src/ble_central.c src/ep_info.c src/ep_request.c src/link_test.c src/shell_cmds.c src/usb_stream.c main/main.c)
```

## Kconfig
```
mainmenu "Base node"

source "Kconfig.zephyr"
```

## prj.conf
```kconfig
CONFIG_LOG=y
# Deferred logging keeps the BT RX thread from blocking on the UART; bump the
# buffer so bursts of incoming packets aren't dropped as readily.
CONFIG_LOG_BUFFER_SIZE=8192

# Shell over the console UART (USB CDC ACM on the nice!nano) for PC control,
# e.g. "start link_test" / "stop link_test".
CONFIG_SHELL=y

# The data stream goes out a second CDC ACM port (see usb_stream.h); line
# control lets it check DTR so nothing is queued while no host has it open.
CONFIG_SERIAL=y
CONFIG_UART_INTERRUPT_DRIVEN=y
CONFIG_UART_LINE_CTRL=y
CONFIG_RING_BUFFER=y

CONFIG_BT=y
CONFIG_BT_CENTRAL=y
CONFIG_BT_GATT_CLIENT=y
CONFIG_BT_DEVICE_NAME="base"

# Match ep_device's 247-byte ATT MTU so its NUS packets (larger than the
# default 20-byte notification payload) fit in a single notification.
CONFIG_BT_L2CAP_TX_MTU=247
CONFIG_BT_BUF_ACL_TX_SIZE=251
CONFIG_BT_BUF_ACL_RX_SIZE=251
CONFIG_BT_CTLR_DATA_LENGTH_MAX=251

# Receive throughput. With the default single controller RX buffer the link layer
# NACKs every packet after the first until the host has taken it, so connection
# events carry few packets. 18 is the controller's maximum; the host gets enough
# ACL buffers to keep up.
CONFIG_BT_CTLR_RX_BUFFERS=18
CONFIG_BT_BUF_ACL_RX_COUNT=20
```

## boards/adafruit_itsybitsy_nrf52840.overlay
```dts
/* nice!nano: built as the ItsyBitsy nRF52840, which has the same Adafruit UF2
 * bootloader layout. The board already provides cdc_acm_uart0 for the shell and
 * logs; this adds a second USB serial port for the binary data stream. */
&zephyr_udc0 {
	cdc_acm_uart1: cdc_acm_uart1 {
		compatible = "zephyr,cdc-acm-uart";
	};
};
```

## src/ble_central.c
```c
#include <string.h>

#include <zephyr/kernel.h>
#include <zephyr/logging/log.h>

#include <zephyr/bluetooth/bluetooth.h>
#include <zephyr/bluetooth/conn.h>
#include <zephyr/bluetooth/gatt.h>
#include <zephyr/bluetooth/uuid.h>
#include <zephyr/bluetooth/services/nus.h>

#include "ble_central.h"

LOG_MODULE_REGISTER(ble_central, CONFIG_LOG_DEFAULT_LEVEL);

// delay between attempts to get a lost ep_device back
#define RECONNECT_DELAY K_SECONDS(1)
#define SCAN_TABLE_SIZE 16

static struct bt_uuid_128 nus_srv_uuid = BT_UUID_INIT_128(BT_UUID_NUS_SRV_VAL);
static struct bt_uuid_128 nus_tx_uuid = BT_UUID_INIT_128(BT_UUID_NUS_TX_CHAR_VAL);
static struct bt_uuid_128 nus_rx_uuid = BT_UUID_INIT_128(BT_UUID_NUS_RX_CHAR_VAL);
/* ep_device's neural data service. Mirrors ep_device/src/ble_handler.c; keep the
 * two in sync. */
static struct bt_uuid_128 data_srv_uuid = BT_UUID_INIT_128(
    BT_UUID_128_ENCODE(0xa3c10000, 0x5f2e, 0x4b8a, 0x9d61, 0x7e4f0c2b9a10));
static struct bt_uuid_128 data_char_uuid = BT_UUID_INIT_128(
    BT_UUID_128_ENCODE(0xa3c10001, 0x5f2e, 0x4b8a, 0x9d61, 0x7e4f0c2b9a10));
/* Must be static: discover_params keeps a pointer to it across ATT requests, so
 * BT_UUID_GATT_CCC (a compound literal scoped to the callback) would dangle. */
static struct bt_uuid_16 ccc_uuid = BT_UUID_INIT_16(BT_UUID_GATT_CCC_VAL);

static const struct ble_central_cb *app_cb;

static struct bt_conn *default_conn;
static struct bt_gatt_exchange_params mtu_params;
static struct bt_gatt_discover_params discover_params;
static struct bt_gatt_subscribe_params nus_sub_params;
static struct bt_gatt_subscribe_params data_sub_params;
// the subscription whose CCC descriptor is being discovered
static struct bt_gatt_subscribe_params *pending_sub;

// NUS service handle range, kept so the RX characteristic can be found after TX
static uint16_t nus_start_handle;
static uint16_t nus_end_handle;
// value handle of the ep_device's NUS RX characteristic (0 until discovered)
static uint16_t nus_rx_handle;

/* Connection state, written from the BT RX thread, the system workqueue (retries)
 * and the shell thread, so it is only touched under state_lock. target is the
 * device the user chose; it stays set while reconnecting after a lost link. */
static struct k_spinlock state_lock;
static enum ble_central_state state;
static bool have_target;
static struct ble_central_device target;
static int last_err;

static void reconnect_work_handler(struct k_work *work);
static K_WORK_DELAYABLE_DEFINE(reconnect_work, reconnect_work_handler);

static void set_state(enum ble_central_state s) {
    k_spinlock_key_t key = k_spin_lock(&state_lock);
    state = s;
    k_spin_unlock(&state_lock, key);
}

static uint8_t nus_notify(struct bt_conn *conn, struct bt_gatt_subscribe_params *params,
                          const void *data, uint16_t length) {
    ARG_UNUSED(conn);

    if (!data) {
        LOG_INF("NUS unsubscribed");
        params->value_handle = 0U;
        return BT_GATT_ITER_STOP;
    }

    if (app_cb && app_cb->reply) {
        app_cb->reply(data, length);
    }

    return BT_GATT_ITER_CONTINUE;
}

static uint8_t data_notify(struct bt_conn *conn, struct bt_gatt_subscribe_params *params,
                           const void *data, uint16_t length) {
    ARG_UNUSED(conn);

    if (!data) {
        LOG_INF("Data characteristic unsubscribed");
        params->value_handle = 0U;
        return BT_GATT_ITER_STOP;
    }

    if (app_cb && app_cb->data) {
        app_cb->data(data, length);
    }

    return BT_GATT_ITER_CONTINUE;
}

static bool discovering_data_service(const struct bt_gatt_discover_params *params) {
    return params->uuid == &data_srv_uuid.uuid || params->uuid == &data_char_uuid.uuid ||
           (params->type == BT_GATT_DISCOVER_DESCRIPTOR && pending_sub == &data_sub_params);
}

static void discovery_done(struct bt_gatt_discover_params *params) {
    memset(params, 0, sizeof(*params));
    pending_sub = NULL;
    set_state(BLE_CENTRAL_CONNECTED);

    if (app_cb && app_cb->ready) {
        app_cb->ready();
    }
}

static void subscribe(struct bt_conn *conn, struct bt_gatt_subscribe_params *sub,
                      uint16_t ccc_handle, bt_gatt_notify_func_t notify, const char *name) {
    sub->notify = notify;
    sub->value = BT_GATT_CCC_NOTIFY;
    sub->ccc_handle = ccc_handle;

    int err = bt_gatt_subscribe(conn, sub);
    if (err && err != -EALREADY) {
        LOG_ERR("%s subscribe failed: %d", name, err);
    } else {
        LOG_INF("Subscribed to %s notifications", name);
    }
}

/* Walks NUS service -> TX characteristic -> its CCC (subscribe) -> RX
 * characteristic, then data service -> data characteristic -> its CCC
 * (subscribe). An ep_device without the data service still gets commands. */
static uint8_t discover_func(struct bt_conn *conn, const struct bt_gatt_attr *attr,
                             struct bt_gatt_discover_params *params) {
    if (!attr) {
        if (discovering_data_service(params)) {
            LOG_WRN("ep_device has no neural data characteristic, commands only");
            discovery_done(params);
        } else {
            LOG_ERR("NUS discovery incomplete (type %u)", params->type);
            memset(params, 0, sizeof(*params));
        }
        return BT_GATT_ITER_STOP;
    }

    switch (params->type) {
    case BT_GATT_DISCOVER_PRIMARY: {
        const struct bt_gatt_service_val *svc = attr->user_data;

        if (params->uuid == &nus_srv_uuid.uuid) {
            LOG_DBG("NUS service found, handles 0x%04x-0x%04x", attr->handle, svc->end_handle);
            nus_start_handle = attr->handle;
            nus_end_handle = svc->end_handle;
            params->uuid = &nus_tx_uuid.uuid;
        } else {
            LOG_DBG("Data service found, handles 0x%04x-0x%04x", attr->handle, svc->end_handle);
            params->uuid = &data_char_uuid.uuid;
        }
        params->start_handle = attr->handle + 1;
        params->end_handle = svc->end_handle;
        params->type = BT_GATT_DISCOVER_CHARACTERISTIC;
        break;
    }
    case BT_GATT_DISCOVER_CHARACTERISTIC:
        if (params->uuid == &nus_rx_uuid.uuid) {
            nus_rx_handle = bt_gatt_attr_value_handle(attr);
            LOG_INF("NUS RX characteristic found, ready to send commands");

            params->uuid = &data_srv_uuid.uuid;
            params->start_handle = BT_ATT_FIRST_ATTRIBUTE_HANDLE;
            params->end_handle = BT_ATT_LAST_ATTRIBUTE_HANDLE;
            params->type = BT_GATT_DISCOVER_PRIMARY;
            break;
        }

        // NUS TX or the data characteristic: find its CCC descriptor next
        LOG_DBG("%s characteristic found, handle 0x%04x",
                params->uuid == &nus_tx_uuid.uuid ? "NUS TX" : "Data", attr->handle);
        pending_sub = params->uuid == &nus_tx_uuid.uuid ? &nus_sub_params : &data_sub_params;
        pending_sub->value_handle = bt_gatt_attr_value_handle(attr);
        params->uuid = &ccc_uuid.uuid;
        params->start_handle = attr->handle + 2;
        params->type = BT_GATT_DISCOVER_DESCRIPTOR;
        break;

    case BT_GATT_DISCOVER_DESCRIPTOR:
        if (pending_sub == &data_sub_params) {
            subscribe(conn, &data_sub_params, attr->handle, data_notify, "data");
            discovery_done(params);
            return BT_GATT_ITER_STOP;
        }

        subscribe(conn, &nus_sub_params, attr->handle, nus_notify, "NUS TX");
        params->uuid = &nus_rx_uuid.uuid;
        params->start_handle = nus_start_handle + 1;
        params->end_handle = nus_end_handle;
        params->type = BT_GATT_DISCOVER_CHARACTERISTIC;
        break;

    default:
        return BT_GATT_ITER_STOP;
    }

    int err = bt_gatt_discover(conn, params);
    if (err) {
        LOG_ERR("GATT discovery step failed: %d", err);
    }
    return BT_GATT_ITER_STOP;
}

static void start_nus_discovery(struct bt_conn *conn) {
    discover_params.uuid = &nus_srv_uuid.uuid;
    discover_params.func = discover_func;
    discover_params.start_handle = BT_ATT_FIRST_ATTRIBUTE_HANDLE;
    discover_params.end_handle = BT_ATT_LAST_ATTRIBUTE_HANDLE;
    discover_params.type = BT_GATT_DISCOVER_PRIMARY;

    int err = bt_gatt_discover(conn, &discover_params);
    if (err) {
        LOG_ERR("NUS discovery failed to start: %d", err);
    }
}

static void mtu_exchange_cb(struct bt_conn *conn, uint8_t err,
                            struct bt_gatt_exchange_params *params) {
    ARG_UNUSED(params);

    if (err) {
        LOG_WRN("MTU exchange failed: %u", err);
    } else {
        LOG_INF("MTU exchanged, ATT MTU %u", bt_gatt_get_mtu(conn));
    }

    /* Discover regardless: a failed exchange only limits the payload size. */
    start_nus_discovery(conn);
}

// -- SCANNING --

/* Results of the scan in progress. device_found runs in the BT RX thread and the
 * shell thread copies the table out once scanning has stopped. */
struct scan_entry {
    struct ble_central_device dev;
    bool is_ep; // advertises NUS, so it is an ep_device
};
static struct scan_entry scan_table[SCAN_TABLE_SIZE];
static size_t scan_count;
static struct k_spinlock scan_lock;

struct ad_info {
    char name[BLE_CENTRAL_NAME_MAX + 1];
    bool has_name;
    bool has_nus;
};

static bool parse_ad(struct bt_data *data, void *user_data) {
    struct ad_info *info = user_data;

    switch (data->type) {
    case BT_DATA_NAME_COMPLETE:
    case BT_DATA_NAME_SHORTENED: {
        size_t len = MIN(data->data_len, BLE_CENTRAL_NAME_MAX);
        memcpy(info->name, data->data, len);
        info->name[len] = '\0';
        info->has_name = true;
        break;
    }
    case BT_DATA_UUID128_ALL:
    case BT_DATA_UUID128_SOME:
        for (size_t i = 0; i + BT_UUID_SIZE_128 <= data->data_len; i += BT_UUID_SIZE_128) {
            if (memcmp(&data->data[i], nus_srv_uuid.val, BT_UUID_SIZE_128) == 0) {
                info->has_nus = true;
            }
        }
        break;

    default:
        break;
    }

    return true;
}

/* ep_device puts its name in the ADV_IND and the NUS UUID in the scan response,
 * so reports are merged by address. */
static void device_found(const bt_addr_le_t *addr, int8_t rssi, uint8_t type,
                         struct net_buf_simple *ad) {
    if (type != BT_GAP_ADV_TYPE_ADV_IND && type != BT_GAP_ADV_TYPE_ADV_DIRECT_IND &&
        type != BT_GAP_ADV_TYPE_SCAN_RSP) {
        return;
    }

    struct ad_info info = { 0 };
    bt_data_parse(ad, parse_ad, &info);

    k_spinlock_key_t key = k_spin_lock(&scan_lock);
    struct scan_entry *e = NULL;
    for (size_t i = 0; i < scan_count; i++) {
        if (bt_addr_le_eq(&scan_table[i].dev.addr, addr)) {
            e = &scan_table[i];
            break;
        }
    }
    if (!e && scan_count < SCAN_TABLE_SIZE) {
        e = &scan_table[scan_count++];
        *e = (struct scan_entry){ 0 };
        bt_addr_le_copy(&e->dev.addr, addr);
    }
    if (e) {
        e->dev.rssi = rssi;
        e->is_ep |= info.has_nus;
        if (info.has_name) {
            strcpy(e->dev.name, info.name);
        }
    }
    k_spin_unlock(&scan_lock, key);
}

int ble_central_scan(k_timeout_t duration, struct ble_central_device *out, size_t max) {
    k_spinlock_key_t key = k_spin_lock(&scan_lock);
    scan_count = 0;
    k_spin_unlock(&scan_lock, key);

    /* Active scanning so the NUS UUID in ep_device's scan response is seen too. */
    int err = bt_le_scan_start(BT_LE_SCAN_ACTIVE, device_found);
    if (err) {
        LOG_ERR("Scanning failed to start: %d", err);
        return err;
    }
    k_sleep(duration);
    err = bt_le_scan_stop();
    if (err) {
        LOG_WRN("Failed to stop scanning: %d", err);
    }

    // copy out the ep_devices, strongest signal first
    size_t n = 0;
    key = k_spin_lock(&scan_lock);
    for (size_t i = 0; i < scan_count; i++) {
        if (!scan_table[i].is_ep) {
            continue;
        }
        size_t j = MIN(n, max);
        while (j > 0 && out[j - 1].rssi < scan_table[i].dev.rssi) {
            if (j < max) {
                out[j] = out[j - 1];
            }
            j--;
        }
        if (j < max) {
            out[j] = scan_table[i].dev;
        }
        n = MIN(n + 1, max);
    }
    k_spin_unlock(&scan_lock, key);
    return (int)n;
}

// -- CONNECTION --

/* 30-50 ms interval, no latency, 4 s supervision timeout. ep_device asks for the
 * same after connecting (BT_PERIPHERAL_PREF_* in its prj.conf). */
#define CONN_PARAM BT_LE_CONN_PARAM(BT_GAP_INIT_CONN_INT_MIN, BT_GAP_INIT_CONN_INT_MAX, 0, 400)

static int create_conn(const bt_addr_le_t *addr) {
    return bt_conn_le_create(addr, BT_CONN_LE_CREATE_CONN, CONN_PARAM, &default_conn);
}

static void reconnect_work_handler(struct k_work *work) {
    ARG_UNUSED(work);

    k_spinlock_key_t key = k_spin_lock(&state_lock);
    bool retry = state == BLE_CENTRAL_RECONNECTING && have_target && !default_conn;
    bt_addr_le_t addr = target.addr;
    k_spin_unlock(&state_lock, key);

    if (!retry) {
        return;
    }
    int err = create_conn(&addr);
    if (err) {
        // e.g. -EAGAIN while a scan is running; try again later
        LOG_DBG("Reconnect attempt failed to start: %d", err);
        k_work_reschedule(&reconnect_work, RECONNECT_DELAY);
    }
}

/* The link is gone or never came up: retry if the user still wants this device,
 * else go idle. A first connect that fails goes idle too, so the shell can report it. */
static void link_down(int err) {
    k_spinlock_key_t key = k_spin_lock(&state_lock);
    bool retry = have_target && state != BLE_CENTRAL_CONNECTING;
    if (!retry) {
        have_target = false;
    }
    state = retry ? BLE_CENTRAL_RECONNECTING : BLE_CENTRAL_IDLE;
    last_err = err;
    k_spin_unlock(&state_lock, key);

    if (retry) {
        k_work_reschedule(&reconnect_work, RECONNECT_DELAY);
    }
}

static void connected(struct bt_conn *conn, uint8_t err) {
    if (conn != default_conn) {
        return;
    }

    char addr_str[BT_ADDR_LE_STR_LEN];
    bt_addr_le_to_str(bt_conn_get_dst(conn), addr_str, sizeof(addr_str));

    if (err) {
        LOG_WRN("Failed to connect to %s: 0x%02x", addr_str, err);
        bt_conn_unref(default_conn);
        default_conn = NULL;
        link_down(err);
        return;
    }

    LOG_INF("Connected to %s", addr_str);

    // initiate an MTU exchange, so packets to fit in a single notification.
    mtu_params.func = mtu_exchange_cb;
    int ret = bt_gatt_exchange_mtu(conn, &mtu_params);
    if (ret) {
        LOG_WRN("MTU exchange failed to start: %d", ret);
        start_nus_discovery(conn);
    }
}

static void disconnected(struct bt_conn *conn, uint8_t reason) {
    if (conn != default_conn) {
        return;
    }

    LOG_INF("Disconnected, reason: 0x%02x", reason);

    bt_conn_unref(default_conn);
    default_conn = NULL;
    memset(&nus_sub_params, 0, sizeof(nus_sub_params));
    memset(&data_sub_params, 0, sizeof(data_sub_params));
    pending_sub = NULL;
    nus_rx_handle = 0;

    if (app_cb && app_cb->disconnected) {
        app_cb->disconnected();
    }

    link_down(reason);
}

BT_CONN_CB_DEFINE(conn_callbacks) = {
    .connected = connected,
    .disconnected = disconnected,
};

int ble_central_connect(const struct ble_central_device *dev) {
    k_spinlock_key_t key = k_spin_lock(&state_lock);
    if (state != BLE_CENTRAL_IDLE || default_conn) {
        k_spin_unlock(&state_lock, key);
        return -EALREADY;
    }
    target = *dev;
    have_target = true;
    state = BLE_CENTRAL_CONNECTING;
    last_err = 0;
    k_spin_unlock(&state_lock, key);

    int err = create_conn(&dev->addr);
    if (err) {
        LOG_ERR("Connection create failed: %d", err);
        key = k_spin_lock(&state_lock);
        have_target = false;
        state = BLE_CENTRAL_IDLE;
        last_err = err;
        k_spin_unlock(&state_lock, key);
    }
    return err;
}

int ble_central_disconnect(void) {
    k_spinlock_key_t key = k_spin_lock(&state_lock);
    bool was_idle = state == BLE_CENTRAL_IDLE;
    have_target = false; // no retries from here on
    if (!default_conn) {
        state = BLE_CENTRAL_IDLE;
    }
    k_spin_unlock(&state_lock, key);

    k_work_cancel_delayable(&reconnect_work);
    if (was_idle) {
        return -ENOTCONN;
    }

    struct bt_conn *conn = default_conn ? bt_conn_ref(default_conn) : NULL;
    if (!conn) {
        return 0;
    }
    // also cancels a connection that is still being set up
    int err = bt_conn_disconnect(conn, BT_HCI_ERR_REMOTE_USER_TERM_CONN);
    bt_conn_unref(conn);
    return err;
}

void ble_central_get_status(struct ble_central_status *st) {
    k_spinlock_key_t key = k_spin_lock(&state_lock);
    st->state = state;
    st->target = target;
    st->have_target = have_target;
    st->last_err = last_err;
    k_spin_unlock(&state_lock, key);
}

int ble_central_init(const struct ble_central_cb *cb) {
    app_cb = cb;

    int err = bt_enable(NULL);
    if (err) {
        LOG_ERR("Bluetooth init failed: %d", err);
        return err;
    }

    LOG_INF("Bluetooth initialised, use \"scan\" and \"connect\" to pick an ep_device");
    return 0;
}

int ble_central_send(const void *data, uint16_t len) {
    if (!default_conn || !nus_rx_handle) {
        return -ENOTCONN;
    }

    return bt_gatt_write_without_response(default_conn, nus_rx_handle, data, len, false);
}
```

## src/ble_central.h
```c
#ifndef BLE_CENTRAL_H
#define BLE_CENTRAL_H

#include <stdbool.h>
#include <stddef.h>
#include <stdint.h>

#include <zephyr/bluetooth/addr.h>
#include <zephyr/kernel.h>

#define BLE_CENTRAL_NAME_MAX 29 // longest name that fits in an advertising packet

/* Application hooks, all invoked from the BT stack's context, so they must not
 * block. Any of them may be NULL. */
struct ble_central_cb {
    /* Every notification on the ep_device's neural data characteristic (the
     * sample stream and link test packets). data is only valid for the
     * duration of the call. */
    void (*data)(const uint8_t *data, uint16_t len);
    /* Every NUS TX notification, i.e. replies to commands. Same lifetime. */
    void (*reply)(const uint8_t *data, uint16_t len);
    /* Discovery is done: NUS (and the data characteristic, if the ep_device
     * has it) is subscribed and ble_central_send() can be used. */
    void (*ready)(void);
    void (*disconnected)(void);
};

enum ble_central_state {
    BLE_CENTRAL_IDLE,         // no ep_device chosen
    BLE_CENTRAL_CONNECTING,   // first connection to a chosen ep_device
    BLE_CENTRAL_CONNECTED,    // connected and discovered, ble_central_send() works
    BLE_CENTRAL_RECONNECTING, // link lost; retrying until ble_central_disconnect()
};

struct ble_central_device {
    bt_addr_le_t addr;
    char name[BLE_CENTRAL_NAME_MAX + 1]; // empty if none was advertised
    int8_t rssi;
};

struct ble_central_status {
    enum ble_central_state state;
    bool have_target;
    struct ble_central_device target; // the chosen ep_device, if have_target
    int last_err;                     // HCI reason or -errno of the last failure
};

/* Enables Bluetooth. Nothing is connected until ble_central_connect(). */
int ble_central_init(const struct ble_central_cb *cb);

/* Scans for ep_devices (anything advertising the NUS service) for 'duration',
 * blocking the caller. Fills out[] strongest signal first and returns how many
 * were stored (at most max), or -errno if scanning couldn't start. */
int ble_central_scan(k_timeout_t duration, struct ble_central_device *out, size_t max);

/* Starts connecting to dev, then MTU exchange, discovery and subscription; the
 * state becomes CONNECTED when that is done (poll ble_central_get_status()). If
 * the link is lost later it is retried until ble_central_disconnect(). Returns
 * -EALREADY unless idle. */
int ble_central_connect(const struct ble_central_device *dev);

/* Drops the connection (or the attempt to make one) and stops any retries.
 * Returns -ENOTCONN if already idle. The disconnected hook runs when the link
 * actually goes down. */
int ble_central_disconnect(void);

void ble_central_get_status(struct ble_central_status *st);

/* Writes data to the ep_device's NUS RX characteristic (write without response).
 * Returns -ENOTCONN until connected and NUS RX has been discovered. */
int ble_central_send(const void *data, uint16_t len);

#endif /* BLE_CENTRAL_H */
```

## src/ep_cmd.h
```c
#ifndef EP_CMD_H
#define EP_CMD_H

/* Command opcodes understood by the ep_device. Mirrors enum cmd_opcode in
 * ep_device/src/cmd_handler.h; keep the two in sync. A command is sent as one
 * NUS write: [opcode][payload...]. */
enum ep_cmd_opcode {
    EP_CMD_PING               = 0x01,
    EP_CMD_GET_INFO           = 0x02, /* replies [opcode][info], see ep_info.h */

    EP_CMD_START_RECORDING    = 0x10,
    EP_CMD_STOP_RECORDING     = 0x11,
    EP_CMD_START_STIMULATION  = 0x12,
    EP_CMD_STOP_STIMULATION   = 0x13,
    EP_CMD_STIM_LOAD_BIPHASIC = 0x14,
    EP_CMD_STIM_LOAD_EVENTS   = 0x15,
    EP_CMD_GET_RECORDING_STATS = 0x16,

    EP_CMD_SET_ELECTRODE_MASK = 0x20,

    EP_CMD_START_BLE_LINK_TEST = 0x30,
    EP_CMD_STOP_BLE_LINK_TEST  = 0x31,
};

/* Recording / stimulation payloads and replies are documented in
 * ep_device/src/cmd_handler.h; reject codes mirror ep_device's enum rec_reject
 * (recording.h) and enum stim_reject (stim.h). */
enum ep_rec_reject {
    EP_REC_OK = 0,
    EP_REC_BAD_MASK,
    EP_REC_RATE_TOO_LOW,
    EP_REC_RATE_TOO_HIGH,
    EP_REC_BUSY,
    EP_REC_BAD_BITS,
};

enum ep_stim_reject {
    EP_STIM_OK = 0,
    EP_STIM_NOT_RECORDING,
    EP_STIM_BUSY,
    EP_STIM_BAD_MASK,
    EP_STIM_TOO_SHORT,
    EP_STIM_PERIOD_TOO_SHORT,
    EP_STIM_UNBALANCED,
    EP_STIM_BAD_EVENTS,
    EP_STIM_NO_PROGRAM,
    EP_STIM_RATE_CHANGED,
};

#define EP_STIM_FLAG_ANODIC_FIRST    0x01
#define EP_STIM_FLAG_ALLOW_IMBALANCE 0x02

#endif /* EP_CMD_H */
```

## src/ep_info.c
```c
#include <errno.h>
#include <string.h>

#include <zephyr/kernel.h>
#include <zephyr/logging/log.h>
#include <zephyr/sys/byteorder.h>
#include <zephyr/sys/util.h>

#include "ble_central.h"
#include "ep_cmd.h"
#include "ep_info.h"

LOG_MODULE_REGISTER(ep_info, CONFIG_LOG_DEFAULT_LEVEL);

/* Payload layout, see ep_device/src/device_info.h: 11 fixed bytes followed by
 * three [u8 len][bytes] strings. */
#define EP_INFO_FORMAT    1
#define EP_INFO_FIXED_LEN 11

static K_SEM_DEFINE(reply_sem, 0, 1);
static struct k_spinlock lock;
static struct ep_info last_info;

// reads one [u8 len][bytes] string at *pos into out (NUL terminated, truncated)
static int get_str(const uint8_t *data, uint16_t len, uint16_t *pos, char *out, size_t out_size) {
    if (*pos >= len) {
        return -EINVAL;
    }
    uint8_t str_len = data[(*pos)++];
    if (*pos + str_len > len) {
        return -EINVAL;
    }

    size_t copy = MIN(str_len, out_size - 1);
    memcpy(out, &data[*pos], copy);
    out[copy] = '\0';
    *pos += str_len;
    return 0;
}

void ep_info_on_reply(const uint8_t *data, uint16_t len) {
    if (len < EP_INFO_FIXED_LEN) {
        LOG_WRN("GET_INFO reply too short (%u bytes)", len);
        return;
    }
    if (data[0] != EP_INFO_FORMAT) {
        LOG_WRN("GET_INFO reply has unsupported format %u (expected %u)",
                data[0], EP_INFO_FORMAT);
        return;
    }

    struct ep_info info = {
        .format = data[0],
        .fw_major = data[1],
        .fw_minor = data[2],
        .fw_patch = data[3],
        .hw_revision = data[4],
        .rhs2116_state = data[5],
        .rhs2116_error = (int16_t)sys_get_le16(&data[6]),
        .rhs2116_chip_id = data[8],
        .rhs2116_die_revision = data[9],
        .rhs2116_num_channels = data[10],
    };

    uint16_t pos = EP_INFO_FIXED_LEN;
    if (get_str(data, len, &pos, info.name, sizeof(info.name)) ||
        get_str(data, len, &pos, info.build, sizeof(info.build)) ||
        get_str(data, len, &pos, info.zephyr, sizeof(info.zephyr))) {
        LOG_WRN("GET_INFO reply has malformed strings");
        return;
    }

    k_spinlock_key_t key = k_spin_lock(&lock);
    last_info = info;
    k_spin_unlock(&lock, key);

    k_sem_give(&reply_sem);
}

int ep_info_query(struct ep_info *info, k_timeout_t timeout) {
    // drop any stale reply to an earlier query that timed out
    k_sem_reset(&reply_sem);

    uint8_t cmd = EP_CMD_GET_INFO;
    int ret = ble_central_send(&cmd, sizeof(cmd));
    if (ret) {
        return ret;
    }

    if (k_sem_take(&reply_sem, timeout)) {
        return -ETIMEDOUT;
    }

    k_spinlock_key_t key = k_spin_lock(&lock);
    *info = last_info;
    k_spin_unlock(&lock, key);
    return 0;
}
```

## src/ep_info.h
```c
#ifndef EP_INFO_H
#define EP_INFO_H

#include <stdint.h>

#include <zephyr/kernel.h>

/* State of the ep_device's RHS2116 as it last reported it. Mirrors enum
 * device_info_rhs2116_state in ep_device/src/device_info.h. */
enum ep_info_rhs2116_state {
    EP_INFO_RHS2116_UNKNOWN = 0, /* ep_device hasn't queried the chip yet */
    EP_INFO_RHS2116_OK      = 1,
    EP_INFO_RHS2116_ERROR   = 2, /* querying the chip failed, see rhs2116_error */
    EP_INFO_RHS2116_EMULATED = 3, /* no chip, ep_device built with CONFIG_RHS2116_EMUL */
};

#define EP_INFO_STR_LEN 48

/* Decoded GET_INFO reply. */
struct ep_info {
    uint8_t format;
    uint8_t fw_major;
    uint8_t fw_minor;
    uint8_t fw_patch;
    uint8_t hw_revision;

    uint8_t rhs2116_state;    /* enum ep_info_rhs2116_state */
    int16_t rhs2116_error;    /* negative errno, EP_INFO_RHS2116_ERROR only */
    uint8_t rhs2116_chip_id;  /* these three are valid in EP_INFO_RHS2116_OK/EMULATED only */
    uint8_t rhs2116_die_revision;
    uint8_t rhs2116_num_channels;

    /* NUL terminated, truncated to fit */
    char name[EP_INFO_STR_LEN];
    char build[EP_INFO_STR_LEN];  /* git describe of the ep_device build */
    char zephyr[EP_INFO_STR_LEN]; /* Zephyr version the ep_device was built with */
};

/* Sends GET_INFO to the ep_device and blocks until it replies.
 * Returns 0 and fills *info, -ENOTCONN if the ep_device isn't connected,
 * -ETIMEDOUT if no reply arrived in time, or another BLE send error.
 * Must not be called from the BT stack's context. */
int ep_info_query(struct ep_info *info, k_timeout_t timeout);

/* Hook for the BLE central: payload of a GET_INFO reply (opcode stripped).
 * Called from the BT stack's context. */
void ep_info_on_reply(const uint8_t *data, uint16_t len);

#endif /* EP_INFO_H */
```

## src/ep_request.c
```c
#include <errno.h>
#include <string.h>

#include <zephyr/kernel.h>
#include <zephyr/sys/util.h>

#include "ble_central.h"
#include "ep_request.h"

#define REQ_MAX_LEN 244

static K_MUTEX_DEFINE(req_mutex);
static K_SEM_DEFINE(reply_sem, 0, 1);
static struct k_spinlock lock;

// the pending request, guarded by lock
static int16_t pending_opcode = -1;
static uint8_t *reply_buf;
static uint16_t reply_cap;
static uint16_t reply_len;

bool ep_request_on_reply(const uint8_t *data, uint16_t len) {
    if (len < 1) {
        return false;
    }

    k_spinlock_key_t key = k_spin_lock(&lock);
    if (pending_opcode != data[0]) {
        k_spin_unlock(&lock, key);
        return false;
    }
    reply_len = MIN(len - 1, reply_cap);
    memcpy(reply_buf, &data[1], reply_len);
    pending_opcode = -1;
    k_spin_unlock(&lock, key);

    k_sem_give(&reply_sem);
    return true;
}

int ep_request(uint8_t opcode, const uint8_t *payload, uint16_t len,
               uint8_t *reply, uint16_t reply_size, k_timeout_t timeout) {
    uint8_t cmd[REQ_MAX_LEN];

    if (len + 1 > sizeof(cmd)) {
        return -EINVAL;
    }
    cmd[0] = opcode;
    if (len) {
        memcpy(&cmd[1], payload, len);
    }

    k_mutex_lock(&req_mutex, K_FOREVER);

    k_spinlock_key_t key = k_spin_lock(&lock);
    pending_opcode = opcode;
    reply_buf = reply;
    reply_cap = reply_size;
    reply_len = 0;
    k_sem_reset(&reply_sem);
    k_spin_unlock(&lock, key);

    int ret = ble_central_send(cmd, len + 1);
    if (ret == 0 && k_sem_take(&reply_sem, timeout) != 0) {
        ret = -ETIMEDOUT;
    }

    key = k_spin_lock(&lock);
    pending_opcode = -1;
    if (ret == 0) {
        ret = reply_len;
    }
    k_spin_unlock(&lock, key);

    k_mutex_unlock(&req_mutex);
    return ret;
}
```

## src/ep_request.h
```c
#ifndef EP_REQUEST_H
#define EP_REQUEST_H

#include <stdint.h>

#include <zephyr/kernel.h>

/* Sends [opcode][payload] to the ep_device and blocks until a NUS reply with
 * the same opcode arrives. The reply (opcode stripped) is copied to reply, up
 * to reply_size bytes. Returns the reply length, -ENOTCONN if not connected,
 * -ETIMEDOUT, or another BLE send error. One request at a time; must not be
 * called from the BT stack's context. */
int ep_request(uint8_t opcode, const uint8_t *payload, uint16_t len,
               uint8_t *reply, uint16_t reply_size, k_timeout_t timeout);

/* Hook for the BLE central: a NUS reply that no one else claimed.
 * Returns true if it answered the pending request. */
bool ep_request_on_reply(const uint8_t *data, uint16_t len);

#endif /* EP_REQUEST_H */
```

## src/link_test.c
```c
#include <errno.h>
#include <stdlib.h>
#include <string.h>

#include <zephyr/kernel.h>
#include <zephyr/logging/log.h>
#include <zephyr/sys/atomic.h>
#include <zephyr/sys/byteorder.h>

#include "ble_central.h"
#include "ep_cmd.h"
#include "link_test.h"

LOG_MODULE_REGISTER(link_test, CONFIG_LOG_DEFAULT_LEVEL);

/* ep_device link test packets start with a little-endian u32 sequence number
 * that increments by one per packet, so gaps in it are dropped packets. */
#define SEQ_LEN 4

static atomic_t active;

/* State below is written from the BT RX thread and the window timer (ISR) and
 * read from the shell thread, so it is only touched under lock. */
static struct k_spinlock lock;

/* streaming: packets are arriving and windows are being recorded. Cleared on
 * disconnect and set again by the first packet after the test resumes. */
static bool streaming;
static bool got_first;
static int64_t first_ms;
static int64_t end_ms;

static uint32_t received;
static uint32_t dropped;
static uint64_t bytes;
static uint32_t next_seq;

static uint32_t window_bytes;
static uint32_t windows[LINK_TEST_MAX_WINDOWS];
static uint32_t n_windows;
static bool windows_full;

static bool link_down;
static int64_t down_since;
static uint32_t disconnects;
static uint32_t down_ms;
static uint32_t longest_down_ms;

// -- WINDOW TIMER --

static void window_expiry(struct k_timer *timer) {
    ARG_UNUSED(timer);

    k_spinlock_key_t key = k_spin_lock(&lock);
    if (streaming) {
        if (n_windows < LINK_TEST_MAX_WINDOWS) {
            windows[n_windows++] = window_bytes;
        } else {
            windows_full = true;
        }
    }
    window_bytes = 0;
    k_spin_unlock(&lock, key);
}

static K_TIMER_DEFINE(window_timer, window_expiry, NULL);

// call with lock held
static void end_downtime(int64_t now) {
    if (!link_down) {
        return;
    }
    uint32_t dur = (uint32_t)(now - down_since);
    down_ms += dur;
    longest_down_ms = MAX(longest_down_ms, dur);
    link_down = false;
}

// -- BLE HOOKS --

void link_test_on_packet(const uint8_t *data, uint16_t len) {
    if (!atomic_get(&active) || len < SEQ_LEN) {
        return;
    }

    uint32_t seq = sys_get_le32(data);
    int64_t now = k_uptime_get();

    k_spinlock_key_t key = k_spin_lock(&lock);

    if (!streaming) {
        /* First packet of the test, or after a reconnect: the ep_device restarts
         * its sequence numbers, so take this one as the new baseline (packets
         * lost to the disconnect are reported as downtime, not drops) and start
         * the windows from here so setup time isn't counted as a slow window. */
        streaming = true;
        end_downtime(now);
        if (!got_first) {
            got_first = true;
            first_ms = now;
        }
        next_seq = seq;
        window_bytes = 0;
        k_timer_start(&window_timer, K_MSEC(LINK_TEST_WINDOW_MS), K_MSEC(LINK_TEST_WINDOW_MS));
    } else if (seq > next_seq) {
        dropped += seq - next_seq;
    }
    // seq < next_seq would be a duplicate/reorder, which BLE shouldn't produce

    received++;
    bytes += len;
    window_bytes += len;
    next_seq = seq + 1;

    k_spin_unlock(&lock, key);
}

void link_test_on_disconnect(void) {
    if (!atomic_get(&active)) {
        return;
    }

    k_spinlock_key_t key = k_spin_lock(&lock);
    k_timer_stop(&window_timer);
    disconnects++;
    if (!link_down) {
        link_down = true;
        down_since = k_uptime_get();
    }
    // the window in progress is cut short, so it's discarded
    streaming = false;
    window_bytes = 0;
    k_spin_unlock(&lock, key);

    LOG_WRN("link test: ep_device disconnected, will resume on reconnect");
}

/* The ep_device stops its link test when the link drops, so restart it once
 * NUS is usable again. Runs on the system workqueue rather than the BT RX
 * thread, which must not block on a TX buffer. */
static void resume_work_handler(struct k_work *work) {
    ARG_UNUSED(work);

    if (!atomic_get(&active)) {
        return;
    }

    uint8_t cmd = EP_CMD_START_BLE_LINK_TEST;
    int ret = ble_central_send(&cmd, sizeof(cmd));
    if (ret) {
        LOG_ERR("link test: failed to resume: %d", ret);
    } else {
        LOG_INF("link test: resumed after reconnect");
    }
}

static K_WORK_DEFINE(resume_work, resume_work_handler);

void link_test_on_ready(void) {
    if (atomic_get(&active)) {
        k_work_submit(&resume_work);
    }
}

// -- CONTROL --

bool link_test_active(void) {
    return atomic_get(&active);
}

int link_test_start(void) {
    if (!atomic_cas(&active, 0, 1)) {
        return -EALREADY;
    }

    // counting is enabled before the ep_device starts sending so sequence 0 isn't missed
    k_spinlock_key_t key = k_spin_lock(&lock);
    streaming = false;
    got_first = false;
    first_ms = 0;
    end_ms = 0;
    received = 0;
    dropped = 0;
    bytes = 0;
    next_seq = 0;
    window_bytes = 0;
    n_windows = 0;
    windows_full = false;
    link_down = false;
    disconnects = 0;
    down_ms = 0;
    longest_down_ms = 0;
    k_spin_unlock(&lock, key);

    uint8_t cmd = EP_CMD_START_BLE_LINK_TEST;
    int ret = ble_central_send(&cmd, sizeof(cmd));
    if (ret) {
        atomic_clear(&active);
        return ret;
    }
    return 0;
}

int link_test_stop(struct link_test_stats *stats) {
    if (!atomic_cas(&active, 1, 0)) {
        return -EALREADY;
    }

    int64_t now = k_uptime_get();

    k_spinlock_key_t key = k_spin_lock(&lock);
    k_timer_stop(&window_timer);
    streaming = false;
    end_ms = now;
    end_downtime(now);
    k_spin_unlock(&lock, key);

    uint8_t cmd = EP_CMD_STOP_BLE_LINK_TEST;
    int ret = ble_central_send(&cmd, sizeof(cmd));

    link_test_get_stats(stats);
    return ret;
}

// -- STATS --

// windows are copied here so they can be sorted without holding the lock
static uint32_t scratch[LINK_TEST_MAX_WINDOWS];
static K_MUTEX_DEFINE(scratch_mutex);

static int cmp_u32(const void *a, const void *b) {
    uint32_t x = *(const uint32_t *)a;
    uint32_t y = *(const uint32_t *)b;
    return (x > y) - (x < y);
}

static uint32_t window_to_bps(uint64_t window_bytes_sum, uint32_t n) {
    return (uint32_t)(window_bytes_sum * 1000 / ((uint64_t)n * LINK_TEST_WINDOW_MS));
}

// lowest average over any span of 'span' consecutive windows, or 0 if too few
static uint32_t min_rolling_bps(const uint32_t *w, uint32_t n, uint32_t span) {
    if (n < span) {
        return 0;
    }

    uint64_t sum = 0;
    for (uint32_t i = 0; i < span; i++) {
        sum += w[i];
    }

    uint64_t min_sum = sum;
    for (uint32_t i = span; i < n; i++) {
        sum += w[i];
        sum -= w[i - span];
        min_sum = MIN(min_sum, sum);
    }
    return window_to_bps(min_sum, span);
}

// nearest-rank percentile of an ascending array
static uint32_t percentile_bps(const uint32_t *sorted, uint32_t n, uint32_t pct) {
    return window_to_bps(sorted[(uint64_t)(n - 1) * pct / 100], 1);
}

void link_test_get_stats(struct link_test_stats *stats) {
    memset(stats, 0, sizeof(*stats));

    k_mutex_lock(&scratch_mutex, K_FOREVER);

    int64_t now = k_uptime_get();
    bool running = atomic_get(&active);

    k_spinlock_key_t key = k_spin_lock(&lock);
    stats->running = running;
    if (got_first) {
        stats->elapsed_ms = (uint32_t)((running ? now : end_ms) - first_ms);
    }
    stats->received = received;
    stats->dropped = dropped;
    stats->bytes = bytes;
    stats->windows_full = windows_full;
    stats->disconnects = disconnects;
    stats->down_ms = down_ms;
    stats->longest_down_ms = longest_down_ms;
    if (link_down) {
        // still disconnected: include the outage so far
        uint32_t cur = (uint32_t)(now - down_since);
        stats->down_ms += cur;
        stats->longest_down_ms = MAX(stats->longest_down_ms, cur);
    }
    uint32_t n = n_windows;
    memcpy(scratch, windows, n * sizeof(scratch[0]));
    k_spin_unlock(&lock, key);

    stats->windows = n;
    if (n > 0) {
        uint64_t sum = 0;
        for (uint32_t i = 0; i < n; i++) {
            sum += scratch[i];
        }
        stats->mean_bps = window_to_bps(sum, n);

        // rolling minima need the windows in time order, so before sorting
        stats->min_5s_bps = min_rolling_bps(scratch, n, 5000 / LINK_TEST_WINDOW_MS);
        stats->min_10s_bps = min_rolling_bps(scratch, n, 10000 / LINK_TEST_WINDOW_MS);

        qsort(scratch, n, sizeof(scratch[0]), cmp_u32);
        stats->min_bps = percentile_bps(scratch, n, 0);
        stats->p5_bps = percentile_bps(scratch, n, 5);
        stats->p10_bps = percentile_bps(scratch, n, 10);
        stats->p50_bps = percentile_bps(scratch, n, 50);
        stats->max_bps = percentile_bps(scratch, n, 100);
    }

    k_mutex_unlock(&scratch_mutex);
}
```

## src/link_test.h
```c
#ifndef LINK_TEST_H
#define LINK_TEST_H

#include <stdbool.h>
#include <stdint.h>

/* Throughput is sampled in fixed windows while the ep_device is streaming, so
 * the dips the link goes through (e.g. as an implanted animal moves around) show
 * up in the low percentiles instead of being averaged away. */
#define LINK_TEST_WINDOW_MS   1000
/* One hour of 1 s windows; later windows still count towards the totals. */
#define LINK_TEST_MAX_WINDOWS 3600

/* All rates are payload bytes per second, measured per window. Rates are 0
 * when there aren't enough windows to compute them. */
struct link_test_stats {
    bool running;
    uint32_t elapsed_ms;      /* first packet until now (or until stop) */

    uint32_t received;        /* packets */
    uint32_t dropped;         /* sequence-number gaps while connected */
    uint64_t bytes;

    uint32_t windows;         /* complete windows recorded */
    bool windows_full;        /* hit LINK_TEST_MAX_WINDOWS */
    uint32_t mean_bps;
    uint32_t min_bps;
    uint32_t p5_bps;
    uint32_t p10_bps;
    uint32_t p50_bps;
    uint32_t max_bps;
    /* lowest rolling average over 5 / 10 consecutive windows: the worst dip an
     * ep_device buffer holding that many seconds of data would have to ride out */
    uint32_t min_5s_bps;
    uint32_t min_10s_bps;

    uint32_t disconnects;
    uint32_t down_ms;         /* total time from disconnect to streaming again */
    uint32_t longest_down_ms;
};

/* Resets the stats and tells the ep_device to start streaming link test
 * packets. Returns -EALREADY if running, or the BLE send error. */
int link_test_start(void);

/* Stops the test, tells the ep_device to stop streaming and fills *stats.
 * Returns -EALREADY if no test was running; a failed stop command is returned
 * as its error, but *stats is still filled in. */
int link_test_stop(struct link_test_stats *stats);

/* Stats of the running test, or of the last one if none is running. */
void link_test_get_stats(struct link_test_stats *stats);

bool link_test_active(void);

/* Hooks for the BLE central (called from the BT stack's context). */
void link_test_on_packet(const uint8_t *data, uint16_t len);
void link_test_on_ready(void);
void link_test_on_disconnect(void);

#endif /* LINK_TEST_H */
```

## src/usb_stream.c
```c
#include <errno.h>

#include <zephyr/device.h>
#include <zephyr/drivers/uart.h>
#include <zephyr/kernel.h>
#include <zephyr/logging/log.h>
#include <zephyr/sys/byteorder.h>
#include <zephyr/sys/ring_buffer.h>

#include "usb_stream.h"

LOG_MODULE_REGISTER(usb_stream, CONFIG_LOG_DEFAULT_LEVEL);

/* Room for ~65 full 244-byte notifications, i.e. a few hundred ms of the BLE
 * link's peak rate if the host stalls. */
#define STREAM_BUF_SIZE 16384

static const struct device *const stream_dev = DEVICE_DT_GET(DT_NODELABEL(cdc_acm_uart1));

RING_BUF_DECLARE(stream_buf, STREAM_BUF_SIZE);

/* stream_buf and the counters are written by the BT RX thread and drained from
 * the UART callback, so both sides take the lock. */
static struct k_spinlock lock;
static uint16_t next_seq;
static uint32_t sent;
static uint32_t dropped;
static uint32_t discarded;

static bool port_open(void) {
    uint32_t dtr = 0;

    return uart_line_ctrl_get(stream_dev, UART_LINE_CTRL_DTR, &dtr) == 0 && dtr;
}

static void uart_cb(const struct device *dev, void *user_data) {
    ARG_UNUSED(user_data);

    while (uart_irq_update(dev) && uart_irq_is_pending(dev)) {
        if (!uart_irq_tx_ready(dev)) {
            break;
        }

        k_spinlock_key_t key = k_spin_lock(&lock);
        uint8_t *data;
        uint32_t len = ring_buf_get_claim(&stream_buf, &data, STREAM_BUF_SIZE);
        if (len == 0) {
            uart_irq_tx_disable(dev);
            k_spin_unlock(&lock, key);
            break;
        }
        int filled = uart_fifo_fill(dev, data, len);
        ring_buf_get_finish(&stream_buf, MAX(filled, 0));
        k_spin_unlock(&lock, key);

        if (filled <= 0) {
            // the CDC ACM TX buffer is full; we're called again once it drains
            break;
        }
    }
}

int usb_stream_init(void) {
    if (!device_is_ready(stream_dev)) {
        LOG_ERR("stream port %s not ready", stream_dev->name);
        return -ENODEV;
    }

    uart_irq_callback_set(stream_dev, uart_cb);
    return 0;
}

int usb_stream_send(enum usb_frame_type type, const uint8_t *payload, uint16_t len) {
    uint8_t header[USB_FRAME_HEADER_LEN] = { USB_FRAME_SYNC0, USB_FRAME_SYNC1, type };
    bool open = port_open();

    k_spinlock_key_t key = k_spin_lock(&lock);

    // seq advances for every frame so the host sees a gap for each lost one
    sys_put_le16(next_seq++, &header[3]);
    sys_put_le16(len, &header[5]);

    if (!open) {
        discarded++;
        k_spin_unlock(&lock, key);
        return -EPIPE;
    }
    if (ring_buf_space_get(&stream_buf) < sizeof(header) + len) {
        dropped++;
        k_spin_unlock(&lock, key);
        return -ENOBUFS;
    }

    ring_buf_put(&stream_buf, header, sizeof(header));
    ring_buf_put(&stream_buf, payload, len);
    sent++;

    k_spin_unlock(&lock, key);

    uart_irq_tx_enable(stream_dev);
    return 0;
}

void usb_stream_get_stats(struct usb_stream_stats *stats) {
    stats->port_open = port_open();

    k_spinlock_key_t key = k_spin_lock(&lock);
    stats->sent = sent;
    stats->dropped = dropped;
    stats->discarded = discarded;
    stats->buf_used = ring_buf_size_get(&stream_buf);
    stats->buf_size = ring_buf_capacity_get(&stream_buf);
    k_spin_unlock(&lock, key);
}
```

## src/usb_stream.h
```c
#ifndef USB_STREAM_H
#define USB_STREAM_H

#include <stdbool.h>
#include <stdint.h>

/*
 * Binary frame stream to the PC over the second USB CDC ACM port
 * (cdc_acm_uart1; the shell and logs stay on cdc_acm_uart0).
 *
 * Frame format, multi-byte fields little-endian:
 *
 *   byte 0..1   sync     0xA5 0x5A
 *   byte 2      type     enum usb_frame_type
 *   byte 3..4   seq      u16, +1 per frame, including frames that were dropped
 *   byte 5..6   len      u16, payload length
 *   byte 7..    payload
 *
 * A gap in seq means frames were dropped (buffer full). There is no CRC: USB
 * already checks and retries every packet, so a parser resyncing on the sync
 * bytes should confirm the next frame's sync follows at 7 + len.
 */

#define USB_FRAME_SYNC0      0xA5
#define USB_FRAME_SYNC1      0x5A
#define USB_FRAME_HEADER_LEN 7

enum usb_frame_type {
    /* one notification from the ep_device's neural data characteristic */
    USB_FRAME_DATA = 0x01,
};

struct usb_stream_stats {
    bool port_open;        /* host has the port open (DTR set) */
    uint32_t sent;         /* frames queued for the host */
    uint32_t dropped;      /* frames lost because the buffer was full */
    uint32_t discarded;    /* frames thrown away while the port was closed */
    uint32_t buf_used;     /* bytes waiting in the buffer */
    uint32_t buf_size;
};

/* Sets up the stream port. Returns -ENODEV if it isn't ready. */
int usb_stream_init(void);

/* Queues one frame without blocking, so it is safe from the BT RX thread.
 * Returns -EPIPE if the host doesn't have the port open, -ENOBUFS if the
 * buffer can't fit the whole frame (it is dropped, never truncated). */
int usb_stream_send(enum usb_frame_type type, const uint8_t *payload, uint16_t len);

void usb_stream_get_stats(struct usb_stream_stats *stats);

#endif /* USB_STREAM_H */
```
